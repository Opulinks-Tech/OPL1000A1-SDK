; *************************************************************
; *** Scatter-Loading Description File generated by uVision ***
; *************************************************************

LR_IROM1 0x00414000 0x0002C000  {    ; load region size_region
  RW_IRAM1 0x00414000 0x0002C000  {  ; RO + RW data
   .ANY (+RO)
   .ANY (+RW +ZI)
  }
}