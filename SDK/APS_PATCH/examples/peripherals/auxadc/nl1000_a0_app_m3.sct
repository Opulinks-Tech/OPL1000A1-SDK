; *************************************************************
; *** Scatter-Loading Description File generated by uVision ***
; *************************************************************

LR_IROM1 0x00420000 0x00020000  {    ; load region size_region
  RW_IRAM1 0x00420000 0x00020000  {  ; RO + RW data
   .ANY (+RO)
   .ANY (+RW +ZI)
  }
}
