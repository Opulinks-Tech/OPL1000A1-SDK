; *************************************************************
; *** Scatter-Loading Description File generated by uVision ***
; *************************************************************

LR_IROM1 0x00416400 0x00029C00  {    ; load region size_region
  RW_IRAM1 0x00416400 0x00029C00  {  ; RO + RW data
   .ANY (+RO)
   .ANY (+RW +ZI)
  }
}
